## 02_S3/firmware/main/Kconfig.projbuild
```kconfig
menu "Lidar WiFi bridge"
    config LIDAR_RX_GPIO
        int "Lidar UART RX GPIO"
        range 0 48
        default 4
    config LIDAR_UART_BAUD
        int "Lidar UART baud rate"
        default 115200
    config LIDAR_WIFI_SSID
        string "2.4 GHz WiFi SSID"
        default ""
    config LIDAR_WIFI_PASSWORD
        string "WiFi password"
        default ""
    config LIDAR_TCP_PORT
        int "TCP server port"
        range 1024 65535
        default 8889
endmenu
```

## 02_S3/firmware/sdkconfig.defaults
```kconfig
CONFIG_IDF_TARGET="esp32s3"
CONFIG_ESPTOOLPY_FLASHSIZE_16MB=y
CONFIG_ESPTOOLPY_FLASHMODE_DIO=y
CONFIG_ESPTOOLPY_FLASHFREQ_40M=y
CONFIG_ESP_CONSOLE_UART_DEFAULT=y
CONFIG_ESP_CONSOLE_UART_BAUDRATE=115200
# CONFIG_SPIRAM is not set
CONFIG_LIDAR_RX_GPIO=4
CONFIG_LIDAR_UART_BAUD=115200
```
